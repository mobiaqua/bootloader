## u-boot/arch/arm/Kconfig
```kconfig
menu "ARM architecture"
	depends on ARM

config SYS_ARCH
	default "arm"

config ARM64
	bool

config HAS_VBAR
        bool

config HAS_THUMB2
        bool

config CPU_ARM920T
        bool

config CPU_PXA
        bool

config CPU_SA1100
        bool

config SYS_CPU
        default "arm920t" if CPU_ARM920T
        default "pxa" if CPU_PXA
        default "sa1100" if CPU_SA1100

config SYS_L2CACHE_OFF
	bool "L2cache off"
	help
	  If SoC does not support L2CACHE or one do not want to enable
	  L2CACHE, choose this option.
choice
	prompt "Target select"

config TARGET_H2200
	bool "Support h2200"
	select CPU_PXA

config TARGET_H3600
	bool "Support h3600 iPAQ"
	select CPU_SA1100

config TARGET_H3800
	bool "Support h3800 iPAQ"
	select CPU_SA1100

endchoice

source "board/h2200/Kconfig"
source "board/h3600/Kconfig"
source "board/h3800/Kconfig"

source "arch/arm/Kconfig.debug"

endmenu
```

## u-boot/board/h3600/Kconfig
```kconfig
if TARGET_H3600

config SYS_BOARD
	default "h3600"

config SYS_CONFIG_NAME
	default "h3600"

endif
```

## u-boot/board/h3800/Kconfig
```kconfig
if TARGET_H3800

config SYS_BOARD
	default "h3800"

config SYS_CONFIG_NAME
	default "h3800"

endif
```

## u-boot/configs/h3600_defconfig
```kconfig
CONFIG_ARM=y
CONFIG_TARGET_H3600=y
CONFIG_SYS_PROMPT="> "
# CONFIG_CMD_BDI is not set
# CONFIG_CMD_CONSOLE is not set
# CONFIG_CMD_BOOTD is not set
# CONFIG_CMD_IMLS is not set
# CONFIG_CMD_XIMG is not set
# CONFIG_CMD_MEMORY is not set
# CONFIG_CMD_FPGA is not set
# CONFIG_CMD_ECHO is not set
# CONFIG_CMD_ITEST is not set
# CONFIG_CMD_SETEXPR is not set
# CONFIG_CMD_NFS is not set
# CONFIG_CMD_MISC is not set
```
